## Documentation/devicetree/bindings/arm/omap/iva.txt
```
* TI - IVA (Imaging and Video Accelerator) subsystem

The IVA contain various audio, video or imaging HW accelerator
depending of the version.

Required properties:
- compatible : Should be:
  - "ti,ivahd" for OMAP4
  - "ti,iva2.2" for OMAP3
  - "ti,iva2.1" for OMAP2430
  - "ti,iva1" for OMAP2420
- ti,hwmods: "iva"

Optional properties ("ti,ivahd", for a remote processor's resource manager):
- resets: the sequencer resets, ICONT1 and ICONT2
- reset-names: "seq0", "seq1"
- clocks: the SL2 interface clock
- clock-names: "sl2if"

Examples:

iva {
    compatible = "ti,ivahd", "ti,iva";
    ti,hwmods = "iva";
};
```

## Documentation/devicetree/bindings/display/panel/samsung,ltl090cl01.yaml
```yaml
# SPDX-License-Identifier: (GPL-2.0-only OR BSD-2-Clause)
%YAML 1.2
---
$id: http://devicetree.org/schemas/display/panel/samsung,ltl090cl01.yaml#
$schema: http://devicetree.org/meta-schemas/core.yaml#

title: Samsung LTL090CL01 9" 1920x1280 MIPI DSI panel

maintainers:
  - Krypt1 <mskrypt1@gmail.com>

description:
  A 9" 1920x1280 LCD with a four-lane MIPI DSI video mode interface (RGB666,
  DE-only), used in the Barnes & Noble Nook HD+. Besides VDD it has two
  control inputs, CABC_EN (content adaptive brightness control) and CM_EN
  (color management). The LED backlight needs an external driver.

allOf:
  - $ref: panel-common.yaml#

properties:
  compatible:
    const: samsung,ltl090cl01

  reg:
    maxItems: 1

  power-supply:
    description: VDD, 3.3 V

  cabc-enable-gpios:
    maxItems: 1
    description: GPIO driving the CABC_EN input

  cm-enable-gpios:
    maxItems: 1
    description: GPIO driving the CM_EN input

  backlight: true
  port: true
  rotation: true

required:
  - compatible
  - reg
  - power-supply
  - port

additionalProperties: false

examples:
  - |
    #include <dt-bindings/gpio/gpio.h>

    dsi {
        #address-cells = <1>;
        #size-cells = <0>;

        panel@0 {
            compatible = "samsung,ltl090cl01";
            reg = <0>;
            power-supply = <&vdd_lcd>;
            cabc-enable-gpios = <&gpio1 27 GPIO_ACTIVE_HIGH>;
            cm-enable-gpios = <&gpio5 17 GPIO_ACTIVE_HIGH>;
            backlight = <&lcd_backlight>;

            port {
                panel_in: endpoint {
                    remote-endpoint = <&dsi_out>;
                };
            };
        };
    };

...
```

## Documentation/devicetree/bindings/usb/ti,twl6030-usb.yaml
```yaml
# SPDX-License-Identifier: (GPL-2.0-only OR BSD-2-Clause)
%YAML 1.2
---
$id: http://devicetree.org/schemas/usb/ti,twl6030-usb.yaml#
$schema: http://devicetree.org/meta-schemas/core.yaml#

title: Texas Instruments TWL6030 USB Comparator

maintainers:
  - Peter Ujfalusi <peter.ujfalusi@gmail.com>

description:
  Bindings for the USB comparator module found within the TWL6030
  family of companion chips.

properties:
  compatible:
    const: ti,twl6030-usb

  interrupts:
    items:
      - description: OTG for ID events in host mode
      - description: USB device mode for VBUS events

  usb-supply:
    description:
      Phandle to the VUSB regulator. For TWL6030, this should be the 'vusb'
      regulator. For TWL6032 subclass, it should be the 'ldousb' regulator.

  syscon-chgdet:
    description:
      For USB charger detection by an OMAP4 USB2 PHY, the control module
      syscon and the offset of CONTROL_USB2PHYCORE in it.
    $ref: /schemas/types.yaml#/definitions/phandle-array
    items:
      - items:
          - description: phandle to the control module syscon
          - description: offset of CONTROL_USB2PHYCORE

  phys:
    maxItems: 1
    description: The USB2 PHY, for charger detection.

  phy-names:
    const: usb2-phy

required:
  - compatible
  - interrupts
  - usb-supply

additionalProperties: false

examples:
  - |
    #include <dt-bindings/interrupt-controller/irq.h>

    usb {
        compatible = "ti,twl6030-usb";

        interrupts = <4 IRQ_TYPE_LEVEL_HIGH>, <10 IRQ_TYPE_LEVEL_HIGH>;
        interrupt-parent = <&gic>;

        usb-supply = <&reg_vusb>;
    };
```

## drivers/gpu/drm/pvrsgx/Kconfig
```kconfig
# SPDX-License-Identifier: GPL-2.0-only
#
# Out-of-tree PowerVR SGX kernel driver (openpvrsgx-devgroup layout), reduced
# to the one DDK that matches the OMAP4470's Android user space.
#

config SGX_OMAP4470
	tristate "PowerVR SGX544 rev 112 (OMAP4470), Android DDK 1.14@4081762"
	depends on ARCH_OMAP4 && OF
	depends on PREEMPTION || PREEMPT_VOLUNTARY
	depends on DMA_SHARED_BUFFER && SYNC_FILE
	help
	  Services kernel driver (pvrsrvkm) for the SGX544 SC rev 112 in the
	  TI OMAP4470, built from IMG's GPL DDK 1.14@4081762 with the
	  options of TI's Android build for that chip (blaze_tablet.4470).
	  It exposes /dev/pvrsrvkm for the matching closed user space
	  (libsrv_um, pvrsrvinit, the EGL/GLES libraries).

	  The build options, structure layouts and bridge numbering must
	  match that user space exactly. Android-only kernel interfaces
	  the DDK expects (ION, the staging sync framework, the gpu trace
	  events) are replaced by local shims.

	  If unsure, say N.
```

## drivers/media/platform/ti/omap4-ducati/Kconfig
```kconfig
# SPDX-License-Identifier: GPL-2.0-only
config VIDEO_OMAP4_DUCATI
	tristate "OMAP4 IVA-HD video decoder (IPU firmware)"
	depends on V4L_MEM2MEM_DRIVERS
	depends on VIDEO_DEV
	depends on ARCH_OMAP4 || COMPILE_TEST
	depends on DRM_OMAP
	depends on RPMSG && REMOTEPROC
	select V4L2_MEM2MEM_DEV
	select VIDEOBUF2_DMA_SG
	help
	  A V4L2 stateful H.264 decoder for the OMAP4 IVA-HD, through the
	  OMX server of the IPU (Ducati) firmware ducati-m3.bin over rpmsg.
	  The IPU runs only while a decoder instance needs it. Buffers are
	  mapped for the IVA-HD through omapdrm's TILER.

	  To compile this driver as a module, choose M here: the module
	  will be called omap4-ducati-vdec.
```
